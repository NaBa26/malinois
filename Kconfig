## Kconfig
```kconfig
mainmenu "Root Configuration for Malinois"

    source "main/Kconfig.projbuild"
    source "components/ds3231/Kconfig.projbuild"
```

## components/ds3231/Kconfig.projbuild
```kconfig
menu "DS3231 RTC Module Configuraion"
       config I2C_MASTER_SDA
                    int "SDA GPIO Num"
                    default 21
       config I2C_MASTER_SCL
                    int "SCL GPIO Num"
                    default 22
       config I2C_MASTER_FREQUENCY
                    int "I2C Frequency"
                    default 400000
endmenu
```

## main/Kconfig.projbuild
```kconfig
menu "Wifi Packet Capture Configuration"
        config ENABLE_WIFI_CAPTURE
            bool "Enable WiFi Capture Feature"
            default y
endmenu

menu "DS3231 Time Configuration"

config DS3231_SET_HOUR
    int "Initial hour"
    range 0 23
    default 12
    help
        Set the initial hour for DS3231.

config DS3231_SET_MINUTE
    int "Initial minute"
    range 0 59
    default 30
    help
        Set the initial minute for DS3231.

config DS3231_SET_SECOND
    int "Initial second"
    range 0 59
    default 0
    help
        Set the initial second for DS3231.

endmenu
```
